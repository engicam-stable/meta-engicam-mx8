## conf/machine/icoremx6dl.conf
```bitbake
#@TYPE: Machine
#@NAME: NXP i.MX6QP/Q/DL SABRE Automotive
#@SOC: i.MX6QP/Q/DL
#@DESCRIPTION: Machine configuration for NXP i.MX6QP/Q/DL SABRE Automotive
#@MAINTAINER: Daiane Angolini <daiane.angolini@nxp.com>
#
# This machine replaces the following machines:
#    * imx6qpsabreauto
#    * imx6qsabreauto
#    * imx6dlsabreauto
#    * imx6solosabreauto
# and is able to work for all the machines.

MACHINEOVERRIDES =. "mx6:mx6q:mx6dl:"

require icore-mx6.inc
require conf/machine/include/tune-cortexa9.inc

KERNEL_DEVICETREE = " imx6dl-icore.dtb "
KERNEL_DEVICETREE_use-mainline-bsp = " imx6dl-icore.dtb "

KBUILD_DEFCONFIG = "${S}/arch/arm/configs/imx_v7_defconfig"

UBOOT_MACHINE ?= "imx6qdl_icore_mmc_defconfig"
UBOOT_MAKE_TARGET = "all"
UBOOT_SUFFIX = "img"
SPL_BINARY = "SPL"

# WKS_FILE = "imx-uboot-spl-bootpart.wks"

SERIAL_CONSOLE = "115200 ttymxc3"

MACHINE_FIRMWARE_append_mx6 = " linux-firmware-ath6k"

MACHINE_FEATURES += " pci wifi bluetooth"
```

## conf/machine/icoremx8mm.conf
```bitbake
#@TYPE: Machine
#@NAME: NXP i.MX8MM LPDDR4 Evaluation Kit and i.MX8MM DDR4 Evaluation Kit
#@SOC: i.MX8MM
#@DESCRIPTION: Machine configuration for NXP i.MX8MMini LPDDR4 EVK and i.MX8MMini DDR4 EVK
# Consolidated rootfs to support NXP i.MX8MMini LPDDR4 EVK and i.MX8MMini DDR4 EVK
#@MAINTAINER: Jun Zhu <junzhu@nxp.com>

MACHINEOVERRIDES =. "mx8:mx8m:mx8mm:"

require icore-mx8.inc
require conf/machine/include/arm/arch-arm64.inc

MACHINE_FEATURES += " pci wifi bluetooth optee qca9377 qca6174 bcm43455 bcm4356 bcm4359"

KERNEL_DEVICETREE = "engicam/icore-imx8mm-ctouch2-amp10.dtb"

UBOOT_CONFIG ??= "sd"
UBOOT_CONFIG[sd] = "icore_imx8mm_defconfig"
SPL_BINARY = "spl/u-boot-spl.bin"

# Set DDR FIRMWARE
DDR_FIRMWARE_NAME = "lpddr4_pmu_train_1d_imem.bin lpddr4_pmu_train_1d_dmem.bin lpddr4_pmu_train_2d_imem.bin lpddr4_pmu_train_2d_dmem.bin"

# Set u-boot DTB
UBOOT_DTB_NAME = "icore-imx8mm.dtb"

SERIAL_CONSOLES = "115200;ttymxc1"

IMAGE_BOOTLOADER = "imx-boot"

BOOT_SPACE = "65536"
LOADADDR = ""
UBOOT_MAKE_TARGET = ""
IMX_BOOT_SEEK = "33"
```

## conf/machine/icoremx8xq.conf
```bitbake
#@TYPE: Machine
#@NAME: Engicam iCoreMX8X
#@SOC: i.MX8M
#@DESCRIPTION: Machine configuration for NXP Engicam iCoreMX8X
#@MAINTAINER: support@engicam.com

MACHINEOVERRIDES =. "mx8:mx8qxp:"

require icore-mx8.inc
require conf/machine/include/arm/arch-arm64.inc

MACHINE_FEATURES += " pci wifi bluetooth"
SOC_DEFAULT_IMAGE_FSTYPES = "sdcard"

# Don't include kernels in standard images
RDEPENDS_${KERNEL_PACKAGE_NAME}-base = ""
RDEPENDS_${KERNEL_PACKAGE_NAME}-image = ""

KERNEL_DEVICETREE = "engicam/icore-imx8xq.dtb"

LOADADDR = ""

# Disable the serial console due to auto-serial-console
SERIAL_CONSOLES = "115200;ttyAMA0"

# we do not want to have getty running on tty1 as we run
# auto-serial-console there
USE_VT = "0"

UBOOT_MAKE_TARGET = "u-boot.bin"

SPL_BINARY = \
    "${@bb.utils.contains('COMBINED_FEATURES', 'optee', 'spl/u-boot-spl.bin', \
                                                        '', d)}"

UBOOT_SUFFIX = "bin"
UBOOT_CONFIG ??= "sd"
UBOOT_CONFIG[sd]   = "icore_mx8xq_defconfig,sdcard"

BOARD_TYPE = "icore"

BOOT_SPACE = "65536"
IMAGE_BOOTLOADER = "imx-boot"
IMX_BOOT_SEEK = "32"

KBUILD_DEFCONFIG = "${S}/arch/arm64/configs/icoremx8x_defconfig"
LOADADDR = ""
UBOOT_SUFFIX = "bin"
UBOOT_MAKE_TARGET = ""

IMXBOOT_TARGETS = "flash"
```

## conf/machine/smarcoremx8xq.conf
```bitbake
#@TYPE: Machine
#@NAME: Engicam SMARCOREMX8X
#@SOC: i.MX8X
#@DESCRIPTION: Machine configuration for NXP Engicam SMARCOREMX8X
#@MAINTAINER: support@engicam.com

MACHINEOVERRIDES =. "mx8:mx8x:mx8qxp:"

require icore-mx8.inc
require conf/machine/include/arm/arch-arm64.inc

MACHINE_FEATURES += " pci wifi bluetooth"

KERNEL_DEVICETREE = "engicam/smarcore-imx8xq.dtb"

# Disable the serial console due to auto-serial-console
SERIAL_CONSOLES = "115200;ttyAMA0"

UBOOT_SUFFIX = "bin"
UBOOT_CONFIG ??= "sd"
UBOOT_CONFIG[sd]   = "smarcore_mx8xq_defconfig"

BOARD_TYPE = "smarcore"

BOOT_SPACE = "65536"
IMAGE_BOOTLOADER = "imx-boot"
IMX_BOOT_SEEK = "32"

IMXBOOT_TARGETS = "flash"
```

## conf/machine/ultragea-mx8qm.conf
```bitbake
#@TYPE: Machine
#@NAME: i.MX 8QM B0 MEK
#@DESCRIPTION: i.MX 8QuadMax Multisensory Enablement Kit (MEK) board
#@MAINTAINER: Jun Zhu <junzhu@nxp.com>

MACHINEOVERRIDES =. "mx8:mx8qm:"

require icore-mx8.inc
require conf/machine/include/arm/arch-arm64.inc

MACHINE_FEATURES_append = " qca6174 bcm43455 bcm4356 bcm4359"

PREFERRED_PROVIDER_kernel = "linux-engicam"
PREFERRED_PROVIDER_virtual/kernel = "linux-engicam"
PREFERRED_PROVIDER_virtual/bootloader_imx = "u-boot-engicam"

KBUILD_DEFCONFIG = "${S}/arch/arm64/configs/icoremx8x_defconfig"

# Don't include kernels in standard images
RDEPENDS_${KERNEL_PACKAGE_NAME}-base = ""
RDEPENDS_${KERNEL_PACKAGE_NAME}-image = ""

LOADADDR = ""

# Disable the serial console due to auto-serial-console
SERIAL_CONSOLES = "115200;ttyAMA0"

# we do not want to have getty running on tty1 as we run
# auto-serial-console there
USE_VT = "0"

KERNEL_DEVICETREE = "engicam/ultragea-imx8qm.dtb"


UBOOT_MAKE_TARGET = \
    "${@bb.utils.contains('COMBINED_FEATURES', 'optee', '', \
                                                        'u-boot.bin', d)}"
SPL_BINARY = \
    "${@bb.utils.contains('COMBINED_FEATURES', 'optee', 'spl/u-boot-spl.bin', \
                                                        '', d)}"
UBOOT_SUFFIX = "bin"
UBOOT_CONFIG ??= "sd"
UBOOT_CONFIG_SD = \
    "${@bb.utils.contains('COMBINED_FEATURES', 'optee', 'imx8qm_mek_spl_defconfig', \
                                                        'imx8qm_mek_defconfig', d)}"
UBOOT_CONFIG_FSPI = \
    "${@bb.utils.contains('COMBINED_FEATURES', 'optee', 'imx8qm_mek_spl_fspi_defconfig', \
                                                        'imx8qm_mek_fspi_defconfig', d)}"
UBOOT_CONFIG[sd]   = "ultragea_mx8qm_defconfig,sdcard"

BOOT_SPACE = "65536"
IMAGE_BOOTLOADER = "imx-boot"
IMX_BOOT_SEEK = "32"

IMAGE_BOOTFILES_DEPENDS += "firmware-imx:do_deploy"
IMAGE_BOOTFILES += "hdmitxfw.bin hdmirxfw.bin dpfw.bin"

BOARD_TYPE = "mek"

IMXBOOT_TARGETS_SD = \
    "${@bb.utils.contains('COMBINED_FEATURES', 'optee', 'flash_linux_m4 flash_spl', \
                                                        'flash', d)}"
IMXBOOT_TARGETS_FSPI = \
    "${@bb.utils.contains('COMBINED_FEATURES', 'optee', 'flash_spl_flexspi', \
                                                        'flash_flexspi', d)}"
IMXBOOT_TARGETS = \
    "${@bb.utils.contains('UBOOT_CONFIG',         'sd', '${IMXBOOT_TARGETS_SD}', \
                                                        '${IMXBOOT_TARGETS_FSPI}', d)}"
```
